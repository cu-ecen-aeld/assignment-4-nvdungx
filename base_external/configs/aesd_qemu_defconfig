## base_external/configs/aesd_qemu_defconfig
```kconfig
BR2_aarch64=y
BR2_KERNEL_HEADERS_6_6=y
BR2_PACKAGE_HOST_GDB=y
BR2_CCACHE=y
BR2_TARGET_GENERIC_ROOT_PASSWD="root"
BR2_SYSTEM_DHCP="eth0"
BR2_ROOTFS_POST_IMAGE_SCRIPT="board/qemu/post-image.sh"
BR2_ROOTFS_POST_SCRIPT_ARGS="$(BR2_DEFCONFIG)"
BR2_LINUX_KERNEL=y
BR2_LINUX_KERNEL_USE_CUSTOM_CONFIG=y
BR2_LINUX_KERNEL_CUSTOM_CONFIG_FILE="board/qemu/aarch64-virt/linux.config"
BR2_LINUX_KERNEL_NEEDS_HOST_OPENSSL=y
BR2_PACKAGE_MEMSTAT=y
BR2_PACKAGE_STRACE=y
BR2_PACKAGE_MEMTOOL=y
BR2_PACKAGE_ATFTP=y
BR2_PACKAGE_AUTOSSH=y
BR2_PACKAGE_DHCPCD=y
BR2_PACKAGE_DHCPDUMP=y
BR2_PACKAGE_DROPBEAR=y
BR2_PACKAGE_ETHTOOL=y
BR2_PACKAGE_OPENSSH=y
BR2_PACKAGE_SSHGUARD=y
BR2_PACKAGE_SSHPASS=y
BR2_PACKAGE_SSLH=y
BR2_PACKAGE_TCPDUMP=y
BR2_PACKAGE_TCPING=y
BR2_TARGET_ROOTFS_EXT2=y
BR2_TARGET_ROOTFS_EXT2_4=y
BR2_PACKAGE_HOST_QEMU=y
BR2_PACKAGE_HOST_QEMU_SYSTEM_MODE=y
BR2_PACKAGE_AESD_ASSIGNMENTS=y
```
